## config/west.yml
```yaml
manifest:
  remotes:
    - name: zmkfirmware
      url-base: https://github.com/zmkfirmware
    - name: dexterkbd
      url-base: https://github.com/Dexter-KBD
  projects:
    - name: zmk
      remote: zmkfirmware
      revision: 641514a97db345f499dd50b0360e594270f008fe
      import: app/west.yml
    - name: zmk-dongle-screen
      remote: dexterkbd
      revision: 84d0c89e51d4708244af999d2d7572660afdd8b0
  self:
    path: config
```
